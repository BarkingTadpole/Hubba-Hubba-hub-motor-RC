## main/Kconfig.projbuild
```kconfig
menu "RC car Wi-Fi access point"

    config RC_WIFI_CONTROL_ENABLED
        bool "Host the browser viewer from an ESP32 access point"
        default y
        help
            Create a 2.4 GHz WPA2 access point and serve the complete browser
            viewer directly from the ESP32. No external WLAN, DHCP address,
            or Python bridge is required. The HTTP API retains the existing
            guarded configuration and calibration boundary and never exposes
            arm, throttle, or steering commands.

    config RC_WIFI_AP_SSID
        string "Access-point SSID"
        depends on RC_WIFI_CONTROL_ENABLED
        default "RC-Car-ESP32"

    config RC_WIFI_AP_PASSWORD
        string "Access-point WPA2 password"
        depends on RC_WIFI_CONTROL_ENABLED
        default "rc-car-viewer"
        help
            WPA2 requires 8-63 characters. Change this before operating around
            untrusted devices because connected clients can access guarded
            configuration and calibration actions.

    config RC_WIFI_AP_CHANNEL
        int "2.4 GHz channel"
        depends on RC_WIFI_CONTROL_ENABLED
        range 1 13
        default 1

    config RC_WIFI_AP_MAX_CLIENTS
        int "Maximum connected viewer devices"
        depends on RC_WIFI_CONTROL_ENABLED
        range 1 4
        default 4

    config RC_WIFI_HTTP_PORT
        int "Viewer HTTP port"
        depends on RC_WIFI_CONTROL_ENABLED
        range 80 65535
        default 80

endmenu
```
